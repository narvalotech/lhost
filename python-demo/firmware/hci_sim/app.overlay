/ {
	chosen {
		zephyr,bt-uart = &puart0;
		zephyr,bt-c2h-uart = &puart0;
		zephyr,console = &uart0;
	};

	puart0: _puart_0 {
		status = "okay";
		compatible = "zephyr,posix-pipe-uart";
		current-speed = <0>;
	};
};
