## python-demo/drivers/Kconfig
```kconfig
# Copyright (c) 2024 Nordic Semiconductor ASA
# SPDX-License-Identifier: Apache-2.0
#
config UART_POSIX_PIPE
	bool "UART driver for interacting with named POSIX pipes"
	default y
	depends on DT_HAS_ZEPHYR_POSIX_PIPE_UART_ENABLED
	select TIMER if UART_ASYNC_API
	select TIMER if UART_INTERRUPT_DRIVEN
	select SERIAL_HAS_DRIVER
	select SERIAL_SUPPORT_ASYNC
	select SERIAL_SUPPORT_INTERRUPT

config UART_POSIX_PIPE_RETRY_MS
	int "Retry delay in milliseconds"
	default 1
	depends on UART_POSIX_PIPE
```

## python-demo/dts/bindings/zephyr,posix-pipe.yaml
```yaml
# Copyright (c) 2019, Jan Van Winkel (jan.van_winkel@dxplore.eu)
# SPDX-License-Identifier: Apache-2.0

description: Native POSIX pipe-based UART

compatible: "zephyr,posix-pipe-uart"

include: uart-controller.yaml
```

## west.yml
```yaml
manifest:
  projects:
    - name: zephyr
      url: https://github.com/zephyrproject-rtos/zephyr
      revision: 632d6b9416c1c1813f3304ef29a6eda7954af3c3
      import:
        name-allowlist:
          - bsim
          - hal_nordic
          - tinycrypt
          - nrf_hw_models
```
